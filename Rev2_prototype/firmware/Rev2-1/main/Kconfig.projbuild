## Rev2_prototype/firmware/Rev2-1/main/Kconfig.projbuild
```kconfig
menu "Pin Assignments"

    orsource "$IDF_PATH/examples/common_components/env_caps/$IDF_TARGET/Kconfig.env_caps"

    config GPIO_OPEN_BUTTON
        int "GPIO input open button pin"
        range ENV_GPIO_RANGE_MIN ENV_GPIO_OUT_RANGE_MAX
        default 18
        help
            GPIO pin number to be used for the "open" button.

    config GPIO_CLOSE_BUTTON
        int "GPIO input close button pin"
        range ENV_GPIO_RANGE_MIN ENV_GPIO_OUT_RANGE_MAX
        default 19
        help
            GPIO pin number to be used for the "close" button.

    config DEBOUNCE_INTERVAL
        int "Debounce interval in microseconds"
        default 10000
        help
            Time interval from previous button press in microseconds before which a button press is ignored    
endmenu

menu "Sleep Configuration"
    config TIMER_WAKEUP_TIME_US
        int "Sleep timer wakeup time in us"
        default 60000000
        help
            The duration that the device will sleep between measurements or communication

endmenu

menu "OpenThread CLI Example"

  config OPENTHREAD_AUTO_START
      bool 'Enable the automatic start mode.'
      default False
      help
          If enabled, the Openthread Device will create or connect to thread network with pre-configured
          network parameters automatically. Otherwise, user need to configure Thread via CLI command manually.
endmenu

menu "Example Configuration"
config EXAMPLE_HTTP_ENDPOINT
    string "Example HTTP Endpoint"
    default "192.168.2.99"
    
    help
        Target endpoint host-name for the example to use.
endmenu
```
